## Kconfig
```kconfig
# Copyright (c) 2025 The ZMK Contributors
# SPDX-License-Identifier: MIT

if ZMK_POINTING

config ZMK_INPUT_PROCESSOR_MAGNITUDE_SCALER
    bool "Input Processor that accelerates trackball movement based on the magnitude of the X/Y report"
    default y
    depends on DT_HAS_ZMK_INPUT_PROCESSOR_MAGNITUDE_SCALER_ENABLED

config ZMK_INPUT_PROCESSOR_MOVEMENT_GATE
    bool "Input Processor that gates trackball movement behind an accumulated-magnitude threshold outside the auto-mouse layer"
    default y
    depends on DT_HAS_ZMK_INPUT_PROCESSOR_MOVEMENT_GATE_ENABLED

endif
```

## dts/bindings/input_processors/zmk,input-processor-magnitude-scaler.yaml
```yaml
# Copyright (c) 2025 The ZMK Contributors
# SPDX-License-Identifier: MIT

description: |
  Input Processor that accelerates REL_X/REL_Y trackball movement based on the
  magnitude (hypotenuse) of the most recently seen X/Y pair. Ported from the
  old PMW3610 driver fork's "adjustable mouse speed" feature
  (CONFIG_PMW3610_ADJUSTABLE_MOUSESPEED).

compatible: "zmk,input-processor-magnitude-scaler"

include: ip_zero_param.yaml

properties:
  min-multiplier:
    type: int
    default: 1000
    description: "Minimum multiplier, in thousandths (e.g. 1000 = 1.0x). Old CONFIG_PMW3610_MOUSE_SPEED_MIN."
  max-multiplier:
    type: int
    default: 1500
    description: "Maximum multiplier, in thousandths (e.g. 1500 = 1.5x). Old CONFIG_PMW3610_MOUSE_SPEED_MAX."
  divisor:
    type: int
    default: 10
    description: "Divisor applied to the movement magnitude when computing the multiplier delta."
```

## dts/bindings/input_processors/zmk,input-processor-movement-gate.yaml
```yaml
# Copyright (c) 2025 The ZMK Contributors
# SPDX-License-Identifier: MIT

description: |
  Input Processor that gates REL_X/REL_Y trackball movement behind an
  accumulated-magnitude threshold, so tiny cursor drift does not keep the
  auto-mouse layer (zip_temp_layer) alive. While the configured `layer` is
  active this processor is a pure passthrough (no deadzone). Ported from the
  old PMW3610 driver fork's CONFIG_PMW3610_MOVEMENT_THRESHOLD.

compatible: "zmk,input-processor-movement-gate"

include: ip_zero_param.yaml

properties:
  threshold:
    type: int
    default: 5
    description: "Accumulated |x|+|y| movement required before events are let through. Old CONFIG_PMW3610_MOVEMENT_THRESHOLD."
  layer:
    type: int
    required: true
    description: "Auto-mouse layer number. While this layer is active, the gate is a pure passthrough."
```
